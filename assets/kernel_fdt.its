## assets/kernel_fdt.its
```
/dts-v1/;

/ {
    description = "Simple image with single Linux kernel and FDT blob";
    #address-cells = <1>;

    images {
        kernel {
            description = "Linux kernel";
            data = /incbin/("./zImage");
            type = "kernel";
            arch = "arm";
            os = "linux";
            compression = "none";
            load = <0x08000000>;
            entry = <0x08000000>;
            hash-1 {
                algo = "crc32";
            };
        };
        fdt-1 {
            description = "Flattened Device Tree blob";
            data = /incbin/("./s5l8740.dtb");
            type = "flat_dt";
            arch = "arm";
            compression = "none";
            hash-1 {
                algo = "crc32";
            };
        };
    };

    configurations {
        default = "conf-1";
        conf-1 {
            description = "Boot Linux kernel with FDT blob";
            kernel = "kernel";
            fdt = "fdt-1";
        };
    };
};
```
